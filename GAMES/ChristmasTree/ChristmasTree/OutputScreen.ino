void outputScreen_clear(){
  gb.display.clear();
  gb.display.setColor(DARKGRAY);
  gb.display.fillRect(0,0,80,64);
}

const PROGMEM uint16_t GROUND0_DATA[] = {80,10,1,1,0x632e,0,  0x632e, 0x632e, 0x632e, 0x632e, 0x632e, 0x632e, 0x632e,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 0xdf1c, 0xdf1c};
const PROGMEM uint16_t TREE000_DATA[] = {35,50,1,1,0x632e,0,  0x632e, 0x632e, 0x632e, 0x632e, 0x632e, 0x632e, 0x632e,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 0x632e, 0x632e};
const PROGMEM uint16_t TREE001_DATA[] = {35,50,1,1,0x632e,0,  0x632e, 0x632e, 0x632e, 0x632e, 0x632e, 0x632e, 0x632e,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 0x632e, 0x632e};
const PROGMEM uint16_t TREE002_DATA[] = {35,50,1,1,0x632e,0,  0x632e, 0x632e, 0x632e, 0x632e, 0x632e, 0x632e, 0x632e,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 0x632e, 0x632e};

const PROGMEM uint16_t GIFTS00_DATA[] = {25,21,1,1,0x632e,0,  0x632e, 0x632e, 0x632e, 0x632e, 0x632e, 0x632e, 0x632e,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 0xfcc2, 0x632e};
const PROGMEM uint16_t SANTA00_DATA[] = {34,20,1,1,0x632e,0,  0x632e, 0x632e, 0x632e, 0x632e, 0x632e, 0x632e, 0xe8e4,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 0x0000, 0x632e};
const PROGMEM uint16_t SNOWMAN_DATA[] = {17,27,1,1,0x632e,0,  0x632e, 0x632e, 0x632e, 0x632e, 0x632e, 0x632e, 0x632e,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 0x632e, 0x632e};
const PROGMEM uint16_t CRECHE0_DATA[] = {37,29,1,1,0x632e,0,  0x632e, 0x632e, 0x632e, 0x632e, 0x632e, 0x632e, 0x632e,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 0x632e, 0x632e};

const PROGMEM uint16_t STAR001_DATA[] = {7,7,1,1,0x632e,0,  0x632e, 0x632e, 0x632e, 0xf682, 0x632e, 0x632e, 0x632e,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 0xfcc2, 0x632e};
const PROGMEM uint16_t STAR002_DATA[] = {7,7,1,1,0x632e,0,  0x632e, 0x632e, 0x632e, 0xf8eb, 0x632e, 0x632e, 0x632e,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 0xc02b, 0x632e};
const PROGMEM uint16_t STAR003_DATA[] = {7,7,1,1,0x632e,0,  0x632e, 0x632e, 0x632e, 0x069d, 0x632e, 0x632e, 0x632e,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 0x051d, 0x632e};
const PROGMEM uint16_t STAR004_DATA[] = {7,7,1,1,0x632e,0,  0x632e, 0x632e, 0x632e, 0xd4da, 0x632e, 0x632e, 0x632e,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 0xc3f8, 0x632e};


const PROGMEM uint16_t BOULE01_DATA[] = {4,4,1,1,0x632e,0,  0x632e, 0x8ec9, 0x8ec9, 0x632e, 0x8ec9, 0x8ec9, 0xffff, 0x8ec9, 0x8ec9, 0x8ec9, 0x8ec9, 0x8ec9, 0x632e, 0x8ec9, 0x8ec9, 0x632e};
const PROGMEM uint16_t BOULE02_DATA[] = {4,4,1,1,0x632e,0,  0x632e, 0x164c, 0x164c, 0x632e, 0x164c, 0x164c, 0xffff, 0x164c, 0x164c, 0x164c, 0x164c, 0x164c, 0x632e, 0x164c, 0x164c, 0x632e};
const PROGMEM uint16_t BOULE03_DATA[] = {4,4,1,1,0x632e,0,  0x632e, 0x03bc, 0x03bc, 0x632e, 0x03bc, 0x03bc, 0xffff, 0x03bc, 0x03bc, 0x03bc, 0x03bc, 0x03bc, 0x632e, 0x03bc, 0x03bc, 0x632e};
const PROGMEM uint16_t BOULE04_DATA[] = {4,4,1,1,0x632e,0,  0x632e, 0x051d, 0x051d, 0x632e, 0x051d, 0x051d, 0xffff, 0x051d, 0x051d, 0x051d, 0x051d, 0x051d, 0x632e, 0x051d, 0x051d, 0x632e};
const PROGMEM uint16_t BOULE05_DATA[] = {4,4,1,1,0x632e,0,  0x632e, 0xd4da, 0xd4da, 0x632e, 0xd4da, 0xd4da, 0xffff, 0xd4da, 0xd4da, 0xd4da, 0xd4da, 0xd4da, 0x632e, 0xd4da, 0xd4da, 0x632e};
const PROGMEM uint16_t BOULE06_DATA[] = {4,4,1,1,0x632e,0,  0x632e, 0xc618, 0xc618, 0x632e, 0xc618, 0xc618, 0xffff, 0xc618, 0xc618, 0xc618, 0xc618, 0xc618, 0x632e, 0xc618, 0xc618, 0x632e};
const PROGMEM uint16_t BOULE07_DATA[] = {4,4,1,1,0x632e,0,  0x632e, 0xffff, 0xffff, 0x632e, 0xffff, 0xffff, 0xdf9f, 0xffff, 0xffff, 0xffff, 0xffff, 0xffff, 0x632e, 0xffff, 0xffff, 0x632e};
const PROGMEM uint16_t BOULE08_DATA[] = {4,4,1,1,0x632e,0,  0x632e, 0xff80, 0xff80, 0x632e, 0xff80, 0xff80, 0xffff, 0xff80, 0xff80, 0xff80, 0xff80, 0xff80, 0x632e, 0xff80, 0xff80, 0x632e};
const PROGMEM uint16_t BOULE09_DATA[] = {4,4,1,1,0x632e,0,  0x632e, 0xfbe4, 0xfbe4, 0x632e, 0xfbe4, 0xfbe4, 0xffff, 0xfbe4, 0xfbe4, 0xfbe4, 0xfbe4, 0xfbe4, 0x632e, 0xfbe4, 0xfbe4, 0x632e};
const PROGMEM uint16_t BOULE10_DATA[] = {4,4,1,1,0x632e,0,  0x632e, 0xe8e4, 0xe8e4, 0x632e, 0xe8e4, 0xe8e4, 0xffff, 0xe8e4, 0xe8e4, 0xe8e4, 0xe8e4, 0xe8e4, 0x632e, 0xe8e4, 0xe8e4, 0x632e};
const PROGMEM uint16_t BOULE11_DATA[] = {4,4,1,1,0x632e,0,  0x632e, 0xf3f0, 0xf3f0, 0x632e, 0xf3f0, 0xf3f0, 0xffff, 0xf3f0, 0xf3f0, 0xf3f0, 0xf3f0, 0xf3f0, 0x632e, 0xf3f0, 0xf3f0, 0x632e};

const PROGMEM uint16_t ELEC000_DATA[] = {6, 27, 1, 1, 0x0000, 0, 
    0x6b6d, 0x8a11, 0xb862, 0x0311, 0x6300, 0x0320,
    0x6b6d, 0x9a33, 0xb862, 0x0353, 0x6300, 0x0320,
    0x6b6d, 0x9a33, 0xb862, 0x0353, 0x7380, 0x0320,
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    0xffff, 0xdddb, 0xf4d3, 0x6e9f, 0xff80, 0x37e6

};

const PROGMEM uint16_t SETTING_DATA[] = {78,9,1,1,0x632e,0, 0xffff, 0xffff, 0xffff, 0xffff, 0xffff, 0xffff, 0xffff,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 0xffff, 0xffff};
const PROGMEM uint16_t ARROWL0_DATA[] = {4, 7,1,1,0x632e,0, 0x632e, 0x632e, 0x632e, 0xffff, 0x632e, 0x632e, 0xffff, 0xffff, 0x632e, 0xffff, 0xffff, 0xffff, 0xffff, 0xffff, 0xffff, 0xffff, 0x632e, 0xffff, 0xffff, 0xffff, 0x632e, 0x632e, 0xffff, 0xffff, 0x632e, 0x632e, 0x632e, 0xffff};
const PROGMEM uint16_t ARROWR0_DATA[] = {4, 7,1,1,0x632e,0, 0xffff, 0x632e, 0x632e, 0x632e, 0xffff, 0xffff, 0x632e, 0x632e, 0xffff, 0xffff, 0xffff, 0x632e, 0xffff, 0xffff, 0xffff, 0xffff, 0xffff, 0xffff, 0xffff, 0x632e, 0xffff, 0xffff, 0x632e, 0x632e, 0xffff, 0x632e, 0x632e, 0x632e};
const PROGMEM uint16_t BTNBACK_DATA[] = {22,7,1,1,0x632e,0, 0x632e, 0x632e, 0xffff, 0xffff, 0xffff, 0x632e, 0x632e,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 0x632e, 0x632e};
const PROGMEM uint16_t BTNCUST_DATA[] = {40,7,1,1,0x632e,0, 0x632e, 0x632e, 0xffff, 0xffff, 0xffff, 0x632e, 0x632e,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 0x632e, 0x632e};
const PROGMEM uint16_t BTNMOVE_DATA[] = {25,6,1,1,0x632e,0, 0x632e, 0x632e, 0xffff, 0xffff, 0x632e, 0x632e, 0x632e,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 0x632e, 0x632e};

const PROGMEM uint16_t SNOW_DATA[] = {1,5,1,1,0x632e,0,  0xdf9f, 0xcf7f, 0xffff, 0xe77d, 0xd7df};

void outputScreen_displaySnow(int yy){
  gb.display.setColor(WHITE);
  for(int i=0;i<70;i++){
    gb.display.drawPixel(snow[i],((i+(snowPos/snowSpeed))%70)-1+yy);
  }
}

void outputScreen_displayGround(){
  Image GROUND0 = Image(GROUND0_DATA);
  gb.display.drawImage(0,54,GROUND0 );
}

void outputScreen_displayTree(int x, int y, int type){
  if(type==0){
    Image TREE000 = Image(TREE000_DATA);
    gb.display.drawImage(x,y,TREE000);
  }
  if(type==1){
    Image TREE001 = Image(TREE001_DATA);
    gb.display.drawImage(x,y,TREE001);
  }
  if(type==2){
    Image TREE002 = Image(TREE002_DATA);
    gb.display.drawImage(x,y,TREE002);
  }
}

void outputScreen_displayStar(int x, int y){
  if(tree.starTheme==1){
    Image STAR001 = Image(STAR001_DATA);
    gb.display.drawImage(x+14,y-5,STAR001);
  }
  if(tree.starTheme==2){
    Image STAR002 = Image(STAR002_DATA);
    gb.display.drawImage(x+14,y-5,STAR002);
  }
  if(tree.starTheme==3){
    Image STAR003 = Image(STAR003_DATA);
    gb.display.drawImage(x+14,y-5,STAR003);
  }
  if(tree.starTheme==4){
    Image STAR004 = Image(STAR004_DATA);
    gb.display.drawImage(x+14,y-5,STAR004);
  }

}

void outputScreen_displayElec(int x, int y){
  if(tree.electTheme>0){
    Image ELEC000 = Image(ELEC000_DATA);
    int elecColor=tree.electTheme-1;
    int seqColor = 0;
    
    if(elecSequence==0){
      for(int i = 0; i<38; i++){
        if(tree.electTheme==7){seqColor=-4+(i%4);}
        gb.display.drawImage(x+electric[i].x,y+electric[i].y,ELEC000,elecColor+seqColor,timerElec,1,1);
      }
    }

    if(elecSequence==1){
      for(int i = 0; i<38; i=i+2){
        if(tree.electTheme==7){seqColor=-4+(i%4);}
        gb.display.drawImage(x+electric[i].x,y+electric[i].y,ELEC000,elecColor+seqColor,timerElec,1,1);
      }
      for(int i = 1; i<38; i=i+2){
        if(tree.electTheme==7){seqColor=-4+(i%4);}
        gb.display.drawImage(x+electric[i].x,y+electric[i].y,ELEC000,elecColor+seqColor,26-timerElec,1,1);
      }
    }

    if(elecSequence==2){
      for(int i = 0; i<38; i++){
        if(tree.electTheme==7){seqColor=(seqColor+(i%4));}
        if(timerElec<6){
          gb.display.drawImage(x+electric[i].x,y+electric[i].y,ELEC000,elecColor+seqColor,0,1,1);
          i++;if(tree.electTheme==7){seqColor=-4+(i%4);}
          gb.display.drawImage(x+electric[i].x,y+electric[i].y,ELEC000,elecColor+seqColor,26,1,1);
        }
        
        if(timerElec>=6  && timerElec<12){
          gb.display.drawImage(x+electric[i].x,y+electric[i].y,ELEC000,elecColor+seqColor,26,1,1);
          i++;if(tree.electTheme==7){seqColor=-4+(i%4);}
          gb.display.drawImage(x+electric[i].x,y+electric[i].y,ELEC000,elecColor+seqColor,0,1,1);
        }
        
        if(timerElec>=12 && timerElec<17){
          gb.display.drawImage(x+electric[i].x,y+electric[i].y,ELEC000,elecColor+seqColor,0,1,1);
          i++;if(tree.electTheme==7){seqColor=-4+(i%4);}
          gb.display.drawImage(x+electric[i].x,y+electric[i].y,ELEC000,elecColor+seqColor,26,1,1);
        }
        
        if(timerElec>=17 && timerElec<21){
          gb.display.drawImage(x+electric[i].x,y+electric[i].y,ELEC000,elecColor+seqColor,26,1,1);
          i++;if(tree.electTheme==7){seqColor=-4+(i%4);}
          gb.display.drawImage(x+electric[i].x,y+electric[i].y,ELEC000,elecColor+seqColor,0,1,1);
        }
        
        if(timerElec>=21 && timerElec<24){
          gb.display.drawImage(x+electric[i].x,y+electric[i].y,ELEC000,elecColor+seqColor,0,1,1);
          i++;if(tree.electTheme==7){seqColor=-4+(i%4);}
          gb.display.drawImage(x+electric[i].x,y+electric[i].y,ELEC000,elecColor+seqColor,26,1,1);
        }
        
        if(timerElec>=24 && timerElec<26){
          gb.display.drawImage(x+electric[i].x,y+electric[i].y,ELEC000,elecColor+seqColor,26,1,1);
          i++;if(tree.electTheme==7){seqColor=-4+(i%4);}
          gb.display.drawImage(x+electric[i].x,y+electric[i].y,ELEC000,elecColor+seqColor,0,1,1);
        }
        
        if(timerElec>=26){
          gb.display.drawImage(x+electric[i].x,y+electric[i].y,ELEC000,elecColor+seqColor,0,1,1);
          i++;if(tree.electTheme==7){seqColor=-4+(i%4);}
          gb.display.drawImage(x+electric[i].x,y+electric[i].y,ELEC000,elecColor+seqColor,26,1,1);
        }
      }
    }

    if(elecSequence==3){
      for(int i = 0; i<38; i++){
        if(tree.electTheme==7){seqColor=-4+(i%4);}
        gb.display.drawImage(x+electric[i].x,y+electric[i].y,ELEC000,elecColor+seqColor,26*random(0, 2),1,1);
      }
    }
  }
}

void outputScreen_displayBoule(int x, int y){
  if(tree.ballsTheme>0){
    Image BOULE01 = Image(BOULE01_DATA);
    Image BOULE02 = Image(BOULE02_DATA);
    Image BOULE03 = Image(BOULE03_DATA);
    Image BOULE04 = Image(BOULE04_DATA);
    Image BOULE05 = Image(BOULE05_DATA);
    Image BOULE06 = Image(BOULE06_DATA);
    Image BOULE07 = Image(BOULE07_DATA);
    Image BOULE08 = Image(BOULE08_DATA);
    Image BOULE09 = Image(BOULE09_DATA);
    Image BOULE10 = Image(BOULE10_DATA);
    Image BOULE11 = Image(BOULE11_DATA);
    Image STAR001 = Image(STAR001_DATA);
    Image STAR002 = Image(STAR002_DATA);
    Image STAR003 = Image(STAR003_DATA);
    Image STAR004 = Image(STAR004_DATA);
    
    for(int i = 0; i<10; i++){
      if(bouleTheme[tree.ballsTheme-1][i].type==1){gb.display.drawImage(x+bouleTheme[tree.ballsTheme-1][i].x,y+bouleTheme[tree.ballsTheme-1][i].y,BOULE01_DATA);}
      if(bouleTheme[tree.ballsTheme-1][i].type==2){gb.display.drawImage(x+bouleTheme[tree.ballsTheme-1][i].x,y+bouleTheme[tree.ballsTheme-1][i].y,BOULE02_DATA);}
      if(bouleTheme[tree.ballsTheme-1][i].type==3){gb.display.drawImage(x+bouleTheme[tree.ballsTheme-1][i].x,y+bouleTheme[tree.ballsTheme-1][i].y,BOULE03_DATA);}
      if(bouleTheme[tree.ballsTheme-1][i].type==4){gb.display.drawImage(x+bouleTheme[tree.ballsTheme-1][i].x,y+bouleTheme[tree.ballsTheme-1][i].y,BOULE04_DATA);}
      if(bouleTheme[tree.ballsTheme-1][i].type==5){gb.display.drawImage(x+bouleTheme[tree.ballsTheme-1][i].x,y+bouleTheme[tree.ballsTheme-1][i].y,BOULE05_DATA);}
      if(bouleTheme[tree.ballsTheme-1][i].type==6){gb.display.drawImage(x+bouleTheme[tree.ballsTheme-1][i].x,y+bouleTheme[tree.ballsTheme-1][i].y,BOULE06_DATA);}
      if(bouleTheme[tree.ballsTheme-1][i].type==7){gb.display.drawImage(x+bouleTheme[tree.ballsTheme-1][i].x,y+bouleTheme[tree.ballsTheme-1][i].y,BOULE07_DATA);}
      if(bouleTheme[tree.ballsTheme-1][i].type==8){gb.display.drawImage(x+bouleTheme[tree.ballsTheme-1][i].x,y+bouleTheme[tree.ballsTheme-1][i].y,BOULE08_DATA);}
      if(bouleTheme[tree.ballsTheme-1][i].type==9){gb.display.drawImage(x+bouleTheme[tree.ballsTheme-1][i].x,y+bouleTheme[tree.ballsTheme-1][i].y,BOULE09_DATA);}
      if(bouleTheme[tree.ballsTheme-1][i].type==10){gb.display.drawImage(x+bouleTheme[tree.ballsTheme-1][i].x,y+bouleTheme[tree.ballsTheme-1][i].y,BOULE10_DATA);}
      if(bouleTheme[tree.ballsTheme-1][i].type==11){gb.display.drawImage(x+bouleTheme[tree.ballsTheme-1][i].x,y+bouleTheme[tree.ballsTheme-1][i].y,BOULE11_DATA);}
      if(bouleTheme[tree.ballsTheme-1][i].type==12){gb.display.drawImage(x+bouleTheme[tree.ballsTheme-1][i].x,y+bouleTheme[tree.ballsTheme-1][i].y,STAR001_DATA);}
      if(bouleTheme[tree.ballsTheme-1][i].type==13){gb.display.drawImage(x+bouleTheme[tree.ballsTheme-1][i].x,y+bouleTheme[tree.ballsTheme-1][i].y,STAR002_DATA);}
      if(bouleTheme[tree.ballsTheme-1][i].type==14){gb.display.drawImage(x+bouleTheme[tree.ballsTheme-1][i].x,y+bouleTheme[tree.ballsTheme-1][i].y,STAR003_DATA);}
      if(bouleTheme[tree.ballsTheme-1][i].type==15){gb.display.drawImage(x+bouleTheme[tree.ballsTheme-1][i].x,y+bouleTheme[tree.ballsTheme-1][i].y,STAR004_DATA);}
    }
  }
}

void outputScreen_displayDecoBackground(int xDeco, int yDeco){
  Image GIFTS00 = Image(GIFTS00_DATA);
  if(selectedDeco==1){gb.display.drawImage(xDeco,   yDeco,   GIFTS00);}
  if(selectedDeco==2){gb.display.drawImage(xDeco,   yDeco,   GIFTS00,  GIFTS00_DATA[0]*-1, GIFTS00_DATA[1]);}

  Image SNOWMAN = Image(SNOWMAN_DATA);
  if(selectedDeco==3){gb.display.drawImage(xDeco,   yDeco,   SNOWMAN);}
  if(selectedDeco==4){gb.display.drawImage(xDeco,   yDeco,   SNOWMAN,  SNOWMAN_DATA[0]*-1, SNOWMAN_DATA[1]);}

  Image CRECHE0 = Image(CRECHE0_DATA);
  if(selectedDeco==5){gb.display.drawImage(xDeco,   yDeco,   CRECHE0);}
  if(selectedDeco==6){gb.display.drawImage(xDeco,   yDeco,   CRECHE0,  CRECHE0_DATA[0]*-1, CRECHE0_DATA[1]);}

  Image SANTA00 = Image(SANTA00_DATA);
  if(selectedDeco==7){gb.display.drawImage(xDeco,   yDeco,   SANTA00);}
  if(selectedDeco==8){gb.display.drawImage(xDeco,   yDeco,   SANTA00,  SANTA00_DATA[0]*-1, SANTA00_DATA[1]);}
}

void outputScreen_displayDeco(int xDeco, int yDeco){
  bool check=false;
  int treeBottom = tree.y+50; //50=with of trees

  if(treeBottom<(yDeco+GIFTS00_DATA[1])){
    Image GIFTS00 = Image(GIFTS00_DATA);
    if(selectedDeco==1){gb.display.drawImage(xDeco,   yDeco,   GIFTS00);}
    if(selectedDeco==2){gb.display.drawImage(xDeco,   yDeco,   GIFTS00,  GIFTS00_DATA[0]*-1, GIFTS00_DATA[1]);}
  }

  if(treeBottom<(yDeco+SNOWMAN_DATA[1])){
    Image SNOWMAN = Image(SNOWMAN_DATA);
    if(selectedDeco==3){gb.display.drawImage(xDeco,   yDeco,   SNOWMAN);}
    if(selectedDeco==4){gb.display.drawImage(xDeco,   yDeco,   SNOWMAN,  SNOWMAN_DATA[0]*-1, SNOWMAN_DATA[1]);}
  }

  if(treeBottom<(yDeco+CRECHE0_DATA[1])){
    Image CRECHE0 = Image(CRECHE0_DATA);
    if(selectedDeco==5){gb.display.drawImage(xDeco,   yDeco,   CRECHE0);}
    if(selectedDeco==6){gb.display.drawImage(xDeco,   yDeco,   CRECHE0,  CRECHE0_DATA[0]*-1, CRECHE0_DATA[1]);}
  }

  if(treeBottom<(yDeco+SANTA00_DATA[1])){
    Image SANTA00 = Image(SANTA00_DATA);
    if(selectedDeco==7){gb.display.drawImage(xDeco,   yDeco,   SANTA00);}
    if(selectedDeco==8){gb.display.drawImage(xDeco,   yDeco,   SANTA00,  SANTA00_DATA[0]*-1, SANTA00_DATA[1]);}
  }
}

void outputScreen_displayDeco4Menu(int xDeco, int yDeco){
  Image GIFTS00 = Image(GIFTS00_DATA);
  if(selectedDeco==1){gb.display.drawImage(27,   yDeco-10,   GIFTS00);}
  if(selectedDeco==2){gb.display.drawImage(27,   yDeco-10,   GIFTS00,  GIFTS00_DATA[0]*-1, GIFTS00_DATA[1]);}

  Image SNOWMAN = Image(SNOWMAN_DATA);
  if(selectedDeco==3){gb.display.drawImage(31,   yDeco-10,   SNOWMAN);}
  if(selectedDeco==4){gb.display.drawImage(31,   yDeco-10,   SNOWMAN,  SNOWMAN_DATA[0]*-1, SNOWMAN_DATA[1]);}

  Image CRECHE0 = Image(CRECHE0_DATA);
  if(selectedDeco==5){gb.display.drawImage(21,   yDeco-10,   CRECHE0);}
  if(selectedDeco==6){gb.display.drawImage(21,   yDeco-10,   CRECHE0,  CRECHE0_DATA[0]*-1, CRECHE0_DATA[1]);}

  Image SANTA00 = Image(SANTA00_DATA);
  if(selectedDeco==7){gb.display.drawImage(23,   yDeco-10,   SANTA00);}
  if(selectedDeco==8){gb.display.drawImage(23,   yDeco-10,   SANTA00,  SANTA00_DATA[0]*-1, SANTA00_DATA[1]);}
}


void outputScreen_displayText(){
  Image SETTING = Image(SETTING_DATA);
  Image ARROWL0 = Image(ARROWL0_DATA);
  Image ARROWR0 = Image(ARROWR0_DATA);
  Image BTNCUST = Image(BTNCUST_DATA);
  Image BTNBACK = Image(BTNBACK_DATA);
  
  gb.display.setColor(WHITE);
  gb.display.setCursor(25,1);
  gb.display.print("SETTINGS");

  
  gb.display.drawImage(1,7, SETTING);
  gb.display.setCursor(5,9);

  if(selectedSetting==0){gb.display.print("Snow");}
  if(selectedSetting==1){gb.display.print("Tree - Selection");}
  if(selectedSetting==2){gb.display.print("Tree - Star");}
  if(selectedSetting==3){gb.display.print("Tree - Balls");}
  if(selectedSetting==4){gb.display.print("Tree - Lights");}
  if(selectedSetting==5){gb.display.print("Deco - Selection");}
  if(selectedSetting==6){gb.display.print("Deco - Reverse");}


  if(selectedSetting==0){
    gb.display.drawImage(24,24, ARROWL0);
    gb.display.drawImage(52,24, ARROWR0);
    gb.display.setCursor(34,25);
    if(snowOn==true){gb.display.print("On");}
    else{gb.display.print("Off");}
  }

  if(selectedSetting==1){//tree
    gb.display.drawImage(10,38, ARROWL0);
    gb.display.drawImage(66,38, ARROWR0); 
    gb.display.drawImage(39,57, BTNCUST);
  }

  if(selectedSetting==2){//star
    gb.display.drawImage(10,20, ARROWL0);
    gb.display.drawImage(66,20, ARROWR0);
  }

  if(selectedSetting==3){//balls
    gb.display.drawImage(10,38, ARROWL0);
    gb.display.drawImage(66,38, ARROWR0); 
    if(tree.ballsTheme==3){gb.display.drawImage(39,57, BTNCUST);}
  }

  if(selectedSetting==4){//elec
    gb.display.drawImage(10,38, ARROWL0);
    gb.display.drawImage(66,38, ARROWR0);   
  }

  if(selectedSetting==5){//deco
    gb.display.drawImage(10,38, ARROWL0);
    gb.display.drawImage(66,38, ARROWR0);
    gb.display.drawImage(39,57, BTNCUST);
  }
  gb.display.drawImage(0,57, BTNBACK);
  
}

void outputScreen_diplayTextPos(){
  Image BTNMOVE = Image(BTNMOVE_DATA);
  Image BTNBACK = Image(BTNBACK_DATA);
  gb.display.drawImage(1, 1, BTNMOVE);
  gb.display.drawImage(57,0, BTNBACK);
}

void outputScreen_diplayTextTreeDeco(){
  Image SETTING = Image(SETTING_DATA);
  Image BTNMOVE = Image(BTNMOVE_DATA);
  Image BTNBACK = Image(BTNBACK_DATA);
  Image ARROWR0 = Image(ARROWR0_DATA);
  Image BTNCUST = Image(BTNCUST_DATA);

  gb.display.setColor(WHITE);
  gb.display.setCursor(1,1);
  gb.display.print("CUSTOMIZATION");

  gb.display.drawImage(1,7, SETTING,0,0,11,9);
  gb.display.drawImage(12,7, SETTING,38,0,40,9);
  gb.display.setCursor(5,9);

  if(selectedSubSetting==0){gb.display.print("Selection");}
  if(selectedSubSetting==1){gb.display.print("Type");}
  if(selectedSubSetting==2){gb.display.print("Position");}

  if(selectedSubSetting==0){
    gb.display.setCursor(15,20);
    gb.display.print(selectedTreeDeco+1);
    gb.display.drawImage(44+bouleTheme[2][selectedTreeDeco].x-5,13+bouleTheme[2][selectedTreeDeco].y-1,ARROWR0,1,0,3,7);
  }

  if(selectedSubSetting==1){
    int xx=15;
    int yy=20;
    if(bouleTheme[2][selectedTreeDeco].type==1){gb.display.drawImage(xx,yy,BOULE01_DATA);}
    if(bouleTheme[2][selectedTreeDeco].type==2){gb.display.drawImage(xx,yy,BOULE02_DATA);}
    if(bouleTheme[2][selectedTreeDeco].type==3){gb.display.drawImage(xx,yy,BOULE03_DATA);}
    if(bouleTheme[2][selectedTreeDeco].type==4){gb.display.drawImage(xx,yy,BOULE04_DATA);}
    if(bouleTheme[2][selectedTreeDeco].type==5){gb.display.drawImage(xx,yy,BOULE05_DATA);}
    if(bouleTheme[2][selectedTreeDeco].type==6){gb.display.drawImage(xx,yy,BOULE06_DATA);}
    if(bouleTheme[2][selectedTreeDeco].type==7){gb.display.drawImage(xx,yy,BOULE07_DATA);}
    if(bouleTheme[2][selectedTreeDeco].type==8){gb.display.drawImage(xx,yy,BOULE08_DATA);}
    if(bouleTheme[2][selectedTreeDeco].type==9){gb.display.drawImage(xx,yy,BOULE09_DATA);}
    if(bouleTheme[2][selectedTreeDeco].type==10){gb.display.drawImage(xx,yy,BOULE10_DATA);}
    if(bouleTheme[2][selectedTreeDeco].type==11){gb.display.drawImage(xx,yy,BOULE11_DATA);}
    if(bouleTheme[2][selectedTreeDeco].type==12){gb.display.drawImage(xx-2,yy-2,STAR001_DATA);}
    if(bouleTheme[2][selectedTreeDeco].type==13){gb.display.drawImage(xx-2,yy-2,STAR002_DATA);}
    if(bouleTheme[2][selectedTreeDeco].type==14){gb.display.drawImage(xx-2,yy-2,STAR003_DATA);}
    if(bouleTheme[2][selectedTreeDeco].type==15){gb.display.drawImage(xx-2,yy-2,STAR004_DATA);}
  }
  
  if(selectedSubSetting==2){
    if(isMovingDeco==false){
      gb.display.drawImage(10,17,BTNCUST,0,0,8,7);
      gb.display.drawImage(19,18,BTNMOVE,8,0,17,6);
    }else{
      gb.display.drawImage(10,18,BTNMOVE);
      gb.display.drawImage(10,28,BTNBACK);
    }
  }

  if(isMovingDeco==false){
    gb.display.drawImage(0,57, BTNBACK);
  }
}
